## app/boards/heltec/heltec_t114/Kconfig.heltec_t114
```kconfig
# Copyright (c) 2024 MASSDRIVER EI (massdriver.space)
# SPDX-License-Identifier: Apache-2.0

config BOARD_HELTEC_T114
	select SOC_NRF52840_QIAA
```

## app/boards/heltec/heltec_t114/board.yml
```yaml
board:
  name: heltec_t114
  full_name: Heltec T114
  vendor: others
  socs:
  - name: nrf52840
    variants:
    - name: uf2
```
